## Kconfig
```kconfig
config MWLWIFI
	tristate "Marvell Wireless WiFi driver (mwlwifi)"
	depends on PCI && MAC80211
	select FW_LOADER
	select OF
	---help---
	  Select to build the driver supporting the:

	  Marvell Wireless WiFi 88W8864 modules
	  Marvell Wireless WiFi 88W8897 modules

	  This driver uses the kernel's mac80211 subsystem.

	  If you want to compile the driver as a module (= code which can be
	  inserted in and removed from the running kernel whenever you want),
	  say M here and read <file:Documentation/kbuild/modules.txt>.  The
	  module will be called mwlwifi.
```
